## linux-6.6.48/drivers/a_custom_drv/Kconfig
```kconfig
config ONBOARD_FAN
    tristate "Onboard fan controller driver"
    depends on OF
    default m
    help
      Onboard fan controller driver for STM32MP boards.
      Build as module (m) or built-in (y), or disable (n).
```

## linux-6.6.48/drivers/gpu/drm/gcnano-driver-stm32mp-6.4.19/Kconfig
```kconfig
config GPU_GALCORE
	tristate "GPU_GALCORE support"
	help
	  gcnano driver for stm32mp
```

## linux-6.6.48/net/stm32_deip/Kconfig
```kconfig
config STM32_DEIP
	tristate "DEIP driver for stm32mp2 support"
    help
      DEIP driver for stm32mp2 support.
```

## linux-6.6.48/net/tsn_sw_edge_lkm/Kconfig
```kconfig
config TSN_SW_EDGE_LKM
	tristate "TSN_SW_EDGE_LKM driver for stm32mp2 support"
    help
      tsn switch driver for stm32mp2 support.
```
